## meta-oe-alliance/meta-brands/meta-ini/conf/machine/inihdp.conf
```bitbake
include conf/machine/include/ini-oem.inc

PREFERRED_PROVIDER_virtual/kernel = "linux-ini-hdp"
PREFERRED_VERSION_linux-ini-hdp = "3.14.2"

MACHINE_FEATURES += "bwlcd255 fanctrl fan iniwol dvb-c blindscan-dvbc blindscan-dvbs ci skins1080 multitranscoding extrasplash blindscan-tbs YUV RCA HDMI-IN-HD \
    ${@bb.utils.contains('MACHINEBUILD', 'mbultra', 'inibt' , '', d)} \
    ${@bb.utils.contains('MACHINEBUILD', 'atemionemesis', 'inibt' , '', d)} \
    ${@bb.utils.contains('MACHINEBUILD', 'xpeedlx3', 'inibt dvbc-only' , '', d)} \    
    ${@bb.utils.contains('MACHINEBUILD', 'beyonwizt4', 'dvbc-only' , '', d)} \
"

SOC_FAMILY = "bcm7425"

MACHINE_KERNEL_PR = "r0"

UBI_VOLNAME = "rootfs"
MKUBIFS_ARGS = "-m 4096 -e 1040384 -c 1984"
UBINIZE_ARGS = "-m 4096 -p 1024KiB"

EXTRA_IMAGEDEPENDS = "\
    enigma2-plugin-systemplugins-micomupgrade \
    "

MACHINE_EXTRA_RDEPENDS = "\
    enigma2-plugin-systemplugins-multitranscodingsetup \
    enigma2-plugin-systemplugins-micomupgrade \
    \
    ini-coldboot \
    ini-ethwol \
    "

MACHINE_EXTRA_RRECOMMENDS += "\
    ini-cfe \
    "
```
